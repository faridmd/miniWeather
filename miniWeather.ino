#include <NTPClient.h>
#include<ESP8266WiFi.h>
#include<ESP8266HTTPClient.h>
#include<ArduinoJson.h>
#include<Adafruit_SSD1306.h>
#include<Adafruit_GFX.h>
#include<SPI.h>
#include <WiFiUdp.h>
#include "logo.h"
#include <WiFiManager.h>
#include <ArduinoOTA.h>

// DAY
// Patchy rain nearby
const unsigned char day_176 [] PROGMEM = {
	0xff, 0xff, 0xff, 0xff, 0xff, 0xff, 0xff, 0xff, 0xff, 0xff, 0xff, 0xff, 0xff, 0xff, 0xff, 0xff, 
	0xff, 0xff, 0xff, 0xff, 0xff, 0xff, 0xff, 0xff, 0xff, 0xff, 0xff, 0xff, 0xff, 0xff, 0xff, 0xff, 
	0xff, 0xff, 0xff, 0xff, 0xff, 0xff, 0xff, 0xff, 0xff, 0xff, 0xff, 0xff, 0xff, 0xff, 0xff, 0xff, 
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	0xff, 0xff, 0xff, 0xff, 0xff, 0xff, 0xff, 0xff, 0xff, 0xff, 0xff, 0xff, 0xff, 0xff, 0xff, 0xff
};

// NIGHT
// Partly Cloudy
const unsigned char night_partlyCloudy [] PROGMEM = {
	0xff, 0xff, 0xff, 0xff, 0xff, 0xff, 0xff, 0xff, 0xff, 0xff, 0xff, 0xff, 0xff, 0xff, 0xff, 0xff, 
	0xff, 0xff, 0xff, 0xff, 0xff, 0xff, 0xff, 0xff, 0xff, 0xff, 0xff, 0xff, 0xff, 0xff, 0xff, 0xff, 
	0xff, 0xff, 0xff, 0xff, 0xff, 0xff, 0xff, 0xff, 0xff, 0xff, 0xff, 0xff, 0xff, 0xff, 0xff, 0xff, 
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	0xff, 0xff, 0xff, 0xff, 0xff, 0xff, 0xff, 0xff, 0xff, 0xff, 0xff, 0xff, 0xff, 0xff, 0xff, 0xff
};


extern const unsigned char thunderstorm_rain[];
extern const unsigned char cloudy[];
extern const unsigned char drizzle[];
extern const unsigned char mist[];
extern const unsigned char rain[];
extern const unsigned char sleet[];
extern const unsigned char snow[];
extern const unsigned char thunderstrom_drizzle[];
extern const unsigned char unknown_prep[];

struct IconDef {
  const unsigned char* bitmap;
  int w;
  int h;
};

IconDef all_icons[] = {
  {day_176, 57, 54},
  {night_partlyCloudy, 57, 54},
  {thunderstorm_rain, 60, 57},
  {cloudy, 60, 53},
  {drizzle, 59, 55},
  {mist, 59, 54},
  {rain, 59, 55},
  {sleet, 60, 54},
  {snow, 57, 58},
  {thunderstrom_drizzle, 59, 55},
  {unknown_prep, 59, 54}
};

String url = "https://api.ryzumi.net/api/search/weather?city=tulungagung";
String url_sholat = "https://api.ryzumi.net/api/search/jadwal-sholat?kota=tulungagung";        

Adafruit_SSD1306 display(128, 64, &Wire, -1);

WiFiUDP ntpUDP;
NTPClient timeClient(ntpUDP, "pool.ntp.org", 25200);

int lastMinute = -1;
unsigned long lastCheckTime = 0;
const unsigned long interval = 5000;

String disp_hourStr = "00";
String disp_minStr = "00";
float disp_temp = 0.0;
float disp_feels = 0.0;
String marquee_text = "Menghubungkan...";
String public_ip = "Loading..";
int scrollX = 128;
int current_icon_index = 0;
unsigned long lastScrollTime = 0;

String payload;
WiFiClientSecure client;

void setup() {
  Serial.begin(9600);
  display.begin(SSD1306_SWITCHCAPVCC, 0x3C);  
  delay(300);
  display.setRotation(2);
  display.clearDisplay();
  display.setTextColor(WHITE);
  display.setTextWrap(false);
  // Menggambar array Vertikal secara manual (pixel-by-pixel)
  for (int16_t y = 0; y < 64; y++) {
    for (int16_t x = 0; x < 128; x++) {
      int page = y / 8;
      int byte_idx = page * 128 + x;
      uint8_t pixel_byte = pgm_read_byte(&display_image[byte_idx]);
      if (pixel_byte & (1 << (y % 8))) {
        display.drawPixel(x, y, WHITE);
      }
    }
  }
  display.display();
  delay(2000); // Tahan logo selama 2 detik
  
  display.invertDisplay(0);
  display.clearDisplay();
  display.setCursor(0, 0);
  display.setTextColor(WHITE);
  display.setTextSize(2);
  display.println("CONNECTING");
  display.setCursor(52, 16);
  display.println("TO");
  display.setTextSize(1);
  String saved_ssid = WiFi.SSID();
  if (saved_ssid == "") saved_ssid = "Saved WiFi";
  display.println(saved_ssid);
  display.display();

  WiFiManager wifiManager;
  
  // Callback jika tidak ada WiFi yang tersimpan atau gagal konek
  wifiManager.setAPCallback([](WiFiManager *myWiFiManager) {
    display.clearDisplay();
    display.setCursor(0, 0);
    display.setTextSize(1);
    display.println("WIFI SETUP MODE");
    display.println("");
    display.println("Konek ke Hotspot:");
    display.println(myWiFiManager->getConfigPortalSSID());
    display.println("Buka di Browser:");
    display.println("192.168.4.1");
    display.display();
  });

  // Coba konek ke WiFi yang tersimpan, jika gagal buat Hotspot "Wemos_Cuaca"
  if (!wifiManager.autoConnect("Wemos_Cuaca")) {
    Serial.println("Gagal koneksi dan timeout");
    ESP.restart();
    delay(1000);
  }
  display.setCursor(0, 48);
  display.setTextSize(2);
  display.setTextColor(BLACK, WHITE);
  display.print("Connected");
  display.display();
  delay(500);
  display.clearDisplay();
  display.setTextColor(WHITE);
  timeClient.begin();
  client.setInsecure();

  // Set up OTA
  ArduinoOTA.setHostname("Wemos-Cuaca");
  ArduinoOTA.onStart([]() {
    display.clearDisplay();
    display.setCursor(0, 0);
    display.setTextSize(1);
    display.println("OTA Memulai...");
    display.display();
  });
  ArduinoOTA.onProgress([](unsigned int progress, unsigned int total) {
    display.clearDisplay();
    display.setCursor(0, 0);
    display.setTextSize(1);
    display.println("OTA Update:");
    display.print(progress / (total / 100));
    display.println("%");
    display.display();
  });
  ArduinoOTA.onEnd([]() {
    display.clearDisplay();
    display.setCursor(0, 0);
    display.setTextSize(1);
    display.println("OTA Selesai!");
    display.println("Restarting...");
    display.display();
  });
  ArduinoOTA.begin();
}

void loop() {
  ArduinoOTA.handle();
  unsigned long now = millis();

  if (now - lastScrollTime >= 30) {
    lastScrollTime = now;
    scrollX--;
    int textWidth = marquee_text.length() * 6;
    if (scrollX < -textWidth) {
      scrollX = 128;
    }
    draw_screen();
  }

  if (now - lastCheckTime >= interval) {
    lastCheckTime = now;
    set_weather();
  }
}

void draw_screen() {
  display.clearDisplay();
  
  // Jam
  display.setCursor(62, 0);
  display.setTextSize(2);
  display.println(disp_hourStr + ":" + disp_minStr);
  
  // Kota
  display.setTextSize(1);
  display.setCursor(62, 20);
  display.print("Tulungagung");
  display.drawLine(62, 28, 127, 28, WHITE);

  // Ikon & Suhu
  display.setCursor(62, 32);
  display.setTextSize(2);
  display.print(disp_temp, 1); 
  display.print((char)247); // Simbol derajat
  display.setTextSize(1);
  display.print("C"); // Huruf C berukuran kecil agar pas di ujung layar 
  
  // SSID & IP (Ganti FL) dengan animasi Ping-Pong jika panjang
  display.setTextSize(1);
  String current_text = ((millis() / 4000) % 2 == 0) ? WiFi.SSID() : public_ip;
  int textWidth = current_text.length() * 6;
  int x = 62;
  
  if (textWidth > 66) { // 66 adalah ruang piksel yang tersedia (128 - 62)
    int max_offset = textWidth - 66;
    int cycle = max_offset * 100; // 50ms per piksel x 2 (bolak-balik)
    int t = millis() % cycle;
    int offset = t / 50;
    if (offset > max_offset) {
      offset = (max_offset * 2) - offset;
    }
    x = 62 - offset;
  }
  display.setCursor(x, 48);
  display.print(current_text);

  // Marquee (Software Scroll)
  display.setTextSize(1);
  display.setCursor(scrollX, 56);
  display.print(marquee_text);

  // Menggambar ikon terakhir sebagai penutup (clipping mask) teks yang overlap
  display.drawBitmap(0, 0, all_icons[current_icon_index].bitmap, all_icons[current_icon_index].w, all_icons[current_icon_index].h, BLACK, WHITE);
  display.display();
}

void set_weather(){
  timeClient.update();
  int hours = timeClient.getHours();
  int minutes = timeClient.getMinutes();

  if (minutes == lastMinute) {
    return;
  }
  
  lastMinute = minutes;

  String hourStr = (hours < 10 ? "0" : "") + String(hours);
  String minuteStr = (minutes < 10 ? "0" : "") + String(minutes);

  HTTPClient http;
  http.begin(client, url);
  int httpcode = http.GET();

  while (httpcode != 200) {
    Serial.println("GETTING DATA...");
    delay(1000);
    http.end();
    http.begin(client, url);
    httpcode = http.GET();
  }

  String payload = http.getString();

  JsonDocument doc;
  DeserializationError error = deserializeJson(doc, payload);

  if (error) {
    Serial.print("JSON parsing failed: ");
    Serial.println(error.c_str());
    http.end();
    return;
  }

  JsonObject main = doc["main"];
  JsonObject weather_0 = doc["weather"][0];

  const char* city_name = doc["name"];
  float curr_temp = main["temp"];
  float app_temp = main["feels_like"];
  float wind_spd = doc["wind"]["speed"];
  int kelembapan = main["humidity"];
  const char* desc = weather_0["description"];
  const char* icon_code = weather_0["icon"];

  http.end();

  // Mapping Ikon Berdasarkan Kode OpenWeather
  String icon_str = String(icon_code);
  if (icon_str == "01d" || icon_str == "02d") current_icon_index = 0; // day_176
  else if (icon_str == "01n" || icon_str == "02n") current_icon_index = 1; // night_partlyCloudy
  else if (icon_str == "03d" || icon_str == "03n" || icon_str == "04d" || icon_str == "04n") current_icon_index = 3; // cloudy
  else if (icon_str == "09d" || icon_str == "09n") current_icon_index = 4; // drizzle
  else if (icon_str == "10d" || icon_str == "10n") current_icon_index = 6; // rain
  else if (icon_str == "11d" || icon_str == "11n") current_icon_index = 2; // thunderstorm_rain
  else if (icon_str == "13d" || icon_str == "13n") current_icon_index = 8; // snow
  else if (icon_str == "50d" || icon_str == "50n") current_icon_index = 5; // mist
  else current_icon_index = 10; // unknown_prep

  
  http.begin(client, url_sholat);
  httpcode = http.GET();
  String sholat_str = "";
  if (httpcode == 200) {
    String payload_sholat = http.getString();
    JsonDocument doc_sholat;
    if (!deserializeJson(doc_sholat, payload_sholat)) {
      JsonObject jadwal = doc_sholat["schedules"][0]["jadwal"];
      const char* subuh = jadwal["subuh"];
      const char* dzuhur = jadwal["dzuhur"];
      const char* ashar = jadwal["ashar"];
      const char* maghrib = jadwal["maghrib"];
      const char* isya = jadwal["isya"];
      sholat_str = " | Subuh: " + String(subuh) + " Dzuhur: " + String(dzuhur) + " Ashar: " + String(ashar) + " Maghrib: " + String(maghrib) + " Isya: " + String(isya);
    }
  }
  http.end();

  // Fetch Public IP
  http.begin(client, "https://ifconfig.me/ip");
  httpcode = http.GET();
  if (httpcode == 200) {
    public_ip = http.getString();
  } else if (public_ip == "Loading..") {
    public_ip = WiFi.localIP().toString(); // Fallback ke local IP jika gagal
  }
  http.end();

  // Assign to global variables for drawing
  disp_hourStr = hourStr;
  disp_minStr = minuteStr;
  disp_temp = curr_temp;
  disp_feels = app_temp;
  marquee_text = String(desc) + " " + String(kelembapan) + "%" + sholat_str;
}
